AUTOSAR XML (schema 4-0-3)
package /Ecuc
  module config Os: ecuc-def-edition=4.2.0, implementation-config-variant=VARIANT-PRE-COMPILE
    OsInclude: OsIncludeFileName=target_serial.h
    RxHwSerialInt (OsIsr): OsIsrInterruptNumber=17, OsIsrInterruptPriority=2, OsIsrStackSize=592, OsIsrCategory=CATEGORY_2, OsIsrInterruptSource=ENABLE
