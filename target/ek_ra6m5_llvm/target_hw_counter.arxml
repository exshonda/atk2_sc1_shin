AUTOSAR XML (schema 4-0-3)
package /Ecuc
  module config Os: ecuc-def-edition=4.2.0, implementation-config-variant=VARIANT-PRE-COMPILE
    OsInclude: OsIncludeFileName=target_hw_counter.h
    MAIN_HW_COUNTER (OsCounter):
      OsCounterMaxAllowedValue = 2147483647
      OsCounterMinCycle = 25
      OsCounterTicksPerBase = 25000
      OsSecondsPerTick = 4.0e-08
      OsCounterType = HARDWARE
      OsCounterIsrRef = C2ISR_for_MAIN_HW_COUNTER
    C2ISR_for_MAIN_HW_COUNTER (OsIsr): OsIsrInterruptNumber=18, OsIsrInterruptPriority=1, OsIsrStackSize=592, OsIsrCategory=CATEGORY_2, OsIsrInterruptSource=ENABLE
